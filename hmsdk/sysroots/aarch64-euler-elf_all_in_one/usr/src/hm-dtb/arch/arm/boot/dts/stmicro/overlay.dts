/dts-v1/;
/plugin/;

/* override conflict entries */
/ {
	hm-fixup {
		target-path = "/";
		hm_fixup: __overlay__ {};
	};
};

&hm_fixup {
	interrupt-controller@a0021000 {
		compatible = "hongmeng,virqchip";
		/* The value of irqctrl_id must be the same as
		 * `irqctrl_id` of `gic: interrupt-controller@a0021000` in stm32mp1c.dts
		 */
		irqctrl_id = <0x1000>;
	};
};
