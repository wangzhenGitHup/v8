/*
 * dts file for Hisilicon Hi5651 Development Board
 *
 * Copyright (C) 2016, Hisilicon Ltd.
 *
 */

/dts-v1/;

/include/ "armsd5151t_asic_smp_ecos.dtsi"
/ {
    chosen {
        bootargs = "use_dtb_cmdline resv_bsp_himem=0x200000@0xffe00000 console=ttyAMA0,9600 root=/dev/ram0 rootfstype=ramfs initrd=0x8A000000,XXXXXX ekbox=0x20000$0xFF400000 kbox_mem=0x3e0000@0xFF420000,0x100000 renesas_usb_handoff_disable=1";
    };

    memory {
        device_type = "memory";
        reg = <0x0 0x88000000 0x0 0x76C00000>;
    };
};
