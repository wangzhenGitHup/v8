	aicpudrv@0x1F0200000 {
		compatible = "hisi,mini-aicpudrv-device";

		interrupts = <0 297 1>, <0 299 1>, <0 301 1>, <0 303 1>,
			        <0 305 1>, <0 307 1>, <0 309 1>, <0 311 1>,
				<0 313 1>, <0 315 1>, <0 317 1>, <0 319 1>,
				<0 321 1>, <0 323 1>, <0 325 1>, <0 327 1>,
				<0 304 1>, <0 306 1>, <0 308 1>, <0 310 1>;
		status = "ok";

	};
